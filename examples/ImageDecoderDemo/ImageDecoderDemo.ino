// ═══════════════════════════════════════════════════════════════════════════════
// ImageDecoderDemo.ino - Universal 1-Line JPEG & PNG Rendering Example
//                        Part of AMK_CYD_Universal_TFT (v1.6.4+)
//
// Demonstrates:
//   1. 1-line display & touch initialization with tft.autoSetup()
//   2. High-speed 1-line JPEG decoding via tft.drawJpgFile() or tft.drawJpg()
//   3. High-speed 1-line PNG decoding via tft.drawPngFile() or tft.drawPng()
//   4. Automatic LittleFS / SPIFFS / SD card compatibility
//   5. Works seamlessly across both Classic ESP32 CYD and ESP32-S3 RGB!
// ═══════════════════════════════════════════════════════════════════════════════

#include <Arduino.h>
#include <LittleFS.h>
#include "AMK_CYD_Universal_TFT.h"

// Global hardware instances
AMK_display display;
AMK_touch   touch;
TFT_eSPI    tft;

// 64x64 AMK Sample Logo JPEG (Embedded PROGMEM)
const uint8_t sample_logo_jpg[] PROGMEM = {
  0xFF, 0xD8, 0xFF, 0xE0, 0x00, 0x10, 0x4A, 0x46, 0x49, 0x46, 0x00, 0x01,
  0x01, 0x01, 0x00, 0x60, 0x00, 0x60, 0x00, 0x00, 0xFF, 0xDB, 0x00, 0x43,
  0x00, 0x03, 0x02, 0x02, 0x03, 0x02, 0x02, 0x03, 0x03, 0x03, 0x03, 0x04,
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  0x59, 0x59, 0x1F, 0xFF, 0xD9
};
const uint32_t sample_logo_jpg_len = 2549;



// 64x64 Sample PNG Checkmark (Embedded PROGMEM)
const uint8_t sample_icon_png[] PROGMEM = {
  0x89, 0x50, 0x4E, 0x47, 0x0D, 0x0A, 0x1A, 0x0A, 0x00, 0x00, 0x00, 0x0D,
  0x49, 0x48, 0x44, 0x52, 0x00, 0x00, 0x00, 0x40, 0x00, 0x00, 0x00, 0x40,
  0x08, 0x06, 0x00, 0x00, 0x00, 0xAA, 0x69, 0x71, 0xDE, 0x00, 0x00, 0x00,
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  0x44, 0xAE, 0x42, 0x60, 0x82
};
const uint32_t sample_icon_png_len = 593;



void setup() {
  Serial.begin(115200);
  delay(300);

  Serial.println("\n[AMK_CYD_Universal_TFT] Image Decoder QuickStart Demo");

  // 1-line universal autoSetup initializes panel, PWM backlight, and touch
  tft.autoSetup(3);
  tft.autoCalibrate(); // Auto-calibrates uncalibrated resistive touch (< 1 ms if saved; 0 ms if capacitive)

  // Initialize LittleFS for filesystem demo
  bool fsOk = LittleFS.begin(true);
  if (fsOk) {
    Serial.println("[FS] LittleFS mounted successfully.");

    // Auto-provision sample test images to LittleFS if they don't exist yet
    // This allows the demo to work immediately out-of-the-box!
    if (!LittleFS.exists("/logo.jpg")) {
      File f = LittleFS.open("/logo.jpg", "w");
      if (f) {
        f.write(sample_logo_jpg, sample_logo_jpg_len);
        f.close();
        Serial.println("[FS] Auto-provisioned sample /logo.jpg onto LittleFS.");
      }
    }
    if (!LittleFS.exists("/icon.png")) {
      File f = LittleFS.open("/icon.png", "w");
      if (f) {
        f.write(sample_icon_png, sample_icon_png_len);
        f.close();
        Serial.println("[FS] Auto-provisioned sample /icon.png onto LittleFS.");
      }
    }
  } else {
    Serial.println("[FS] LittleFS mount failed (falling back to PROGMEM direct memory rendering).");
  }

  // Draw header UI
  int16_t screenW = tft.width();
  int16_t screenH = tft.height();

  tft.fillScreen(TFT_BLACK);
  tft.fillRectHGradient(0, 0, screenW, 40, TFT_NAVY, TFT_DARKCYAN);
  tft.setTextColor(TFT_WHITE, TFT_TRANSPARENT);
  tft.setTextDatum(MC_DATUM);
  tft.drawString("AMK Image Decoder (1-Line)", screenW / 2, 20, 2);

  // Responsive two-column layout that fits 320x240, 480x320, and 800x480
  int16_t margin = 10;
  int16_t gap = 10;
  int16_t cardY = 48;
  int16_t cardH = screenH - cardY - 30;
  int16_t cardW = (screenW - (margin * 2) - gap) / 2;

  int16_t card1X = margin;
  int16_t card2X = margin + cardW + gap;

  // ── 1. Demonstrate JPEG Rendering (Filesystem or PROGMEM) ──
#if defined(AMK_HAS_JPEG_DECODER)
  tft.drawRoundRect(card1X, cardY, cardW, cardH, 8, TFT_CYAN);
  tft.fillRect(card1X + 2, cardY + 2, cardW - 4, cardH - 4, 0x0841); // Dark Navy Slate
  tft.setTextDatum(MC_DATUM);
  tft.setTextColor(TFT_CYAN, 0x0841);
  tft.drawString("JPEG Decoder", card1X + cardW / 2, cardY + 14, 2);

  int16_t img1X = card1X + (cardW - 64) / 2;
  int16_t img1Y = cardY + 26;

  bool jpgRendered = false;
  if (fsOk && LittleFS.exists("/logo.jpg")) {
    // 1-Line LittleFS Filesystem Decoding Call!
    jpgRendered = tft.drawJpgFile(LittleFS, "/logo.jpg", img1X, img1Y);
  }
  if (!jpgRendered) {
    // 1-Line Direct Memory Decoding Call!
    tft.drawJpg(sample_logo_jpg, sample_logo_jpg_len, img1X, img1Y);
  }

  tft.setTextColor(TFT_WHITE, 0x0841);
  tft.drawString("tft.drawJpgFile()", card1X + cardW / 2, cardY + cardH - 45, 2);
  tft.setTextColor(TFT_GREENYELLOW, 0x0841);
  tft.drawString("1-Line LittleFS / RAM", card1X + cardW / 2, cardY + cardH - 25, 2);
  tft.setTextColor(TFT_CYAN, 0x0841);
  tft.drawString("64x64 Decoded", card1X + cardW / 2, cardY + cardH - 10, 1);
#else
  tft.drawRoundRect(card1X, cardY, cardW, cardH, 8, TFT_RED);
  tft.fillRect(card1X + 2, cardY + 2, cardW - 4, cardH - 4, 0x2000);
  tft.setTextDatum(MC_DATUM);
  tft.setTextColor(TFT_RED, 0x2000);
  tft.drawString("JPEGDecoder", card1X + cardW / 2, cardY + 30, 2);
  tft.setTextColor(TFT_WHITE, 0x2000);
  tft.drawString("Not Installed", card1X + cardW / 2, cardY + 60, 2);
  tft.drawString("Add via Library Mgr", card1X + cardW / 2, cardY + 90, 2);
#endif

  // ── 2. Demonstrate PNG Rendering (Filesystem or PROGMEM) ──
#if defined(AMK_HAS_PNG_DECODER)
  tft.drawRoundRect(card2X, cardY, cardW, cardH, 8, TFT_GREEN);
  tft.fillRect(card2X + 2, cardY + 2, cardW - 4, cardH - 4, 0x0208); // Dark Emerald Slate
  tft.setTextDatum(MC_DATUM);
  tft.setTextColor(TFT_GREEN, 0x0208);
  tft.drawString("PNG Decoder", card2X + cardW / 2, cardY + 14, 2);

  int16_t img2X = card2X + (cardW - 64) / 2;
  int16_t img2Y = cardY + 26;

  bool pngRendered = false;
  if (fsOk && LittleFS.exists("/icon.png")) {
    // 1-Line LittleFS Filesystem Decoding Call!
    pngRendered = tft.drawPngFile(LittleFS, "/icon.png", img2X, img2Y);
  }
  if (!pngRendered) {
    // 1-Line Direct Memory Decoding Call!
    tft.drawPng(sample_icon_png, sample_icon_png_len, img2X, img2Y);
  }

  tft.setTextColor(TFT_WHITE, 0x0208);
  tft.drawString("tft.drawPngFile()", card2X + cardW / 2, cardY + cardH - 45, 2);
  tft.setTextColor(TFT_GREENYELLOW, 0x0208);
  tft.drawString("1-Line LittleFS / RAM", card2X + cardW / 2, cardY + cardH - 25, 2);
  tft.setTextColor(TFT_GREEN, 0x0208);
  tft.drawString("64x64 Decoded", card2X + cardW / 2, cardY + cardH - 10, 1);
#else
  tft.drawRoundRect(card2X, cardY, cardW, cardH, 8, TFT_DARKGREY);
  tft.fillRect(card2X + 2, cardY + 2, cardW - 4, cardH - 4, 0x1082); // Dark Slate Grey
  tft.setTextDatum(MC_DATUM);
  tft.setTextColor(TFT_YELLOW, 0x1082);
  tft.drawString("PNGdec Library", card2X + cardW / 2, cardY + 30, 2);
  tft.setTextColor(TFT_WHITE, 0x1082);
  tft.drawString("Optional Plugin", card2X + cardW / 2, cardY + 60, 2);
  tft.setTextColor(TFT_LIGHTGREY, 0x1082);
  tft.drawString("Install 'PNGdec'", card2X + cardW / 2, cardY + 90, 2);
  tft.drawString("via Library Mgr", card2X + cardW / 2, cardY + 110, 2);
#endif

  // Status footer
  tft.fillRect(0, screenH - 24, screenW, 24, 0x18C3);
  tft.setTextColor(TFT_YELLOW, 0x18C3);
  tft.setTextDatum(MC_DATUM);
  tft.drawString("Touch screen to draw | Auto-dimming active", screenW / 2, screenH - 12, 2);
}

void loop() {
  // LDR ambient light auto-dimming runs continuously
  tft.adjustBrightness();

  // Interactive touch test
  uint16_t tx, ty;
  if (tft.getTouch(&tx, &ty)) {
    tft.fillCircle(tx, ty, 3, TFT_RED);
  }
  delay(10);
}
